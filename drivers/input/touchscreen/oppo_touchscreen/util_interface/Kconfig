## drivers/input/touchscreen/oppo_touchscreen_old/Goodix/GT9286/Kconfig
```kconfig
#ifdef VENDOR_EDIT

config TOUCHPANEL_GOODIX_GT9286
#   default y
    bool "TP goodix gt9286 IC enable or not for OPPO"
    ---help---
    say Y to enable driver for Touchpanel useing goodix gt9286

#endif
```

## drivers/input/touchscreen/oppo_touchscreen_old/Novatek/NT36525/Kconfig
```kconfig
#ifdef VENDOR_EDIT

config TOUCHPANEL_NOVA_NT36525
#	default y
	bool "TP nova nt36525 IC enable or not for OPPO"
	---help---
	say Y to enable driver for Touchpanel useing nova nt36525

#endif
```

## kernel/Kconfig.freezer
```kconfig
config FREEZER
	def_bool PM_SLEEP || CGROUP_FREEZER

#ifdef VENDOR_EDIT
config ELSA_STUB
	bool "Enable ELSA stub in kernel"
	default n
#endif
```
